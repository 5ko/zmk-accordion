/*
 * Copyright (c) 2020 The ZMK Contributors
 *
 * SPDX-License-Identifier: MIT
 */



#define ZMK_POINTING_DEFAULT_MOVE_VAL 600  // default: 600
#define ZMK_POINTING_DEFAULT_SCRL_VAL 10    // default: 10

#include <behaviors.dtsi>
#include <dt-bindings/zmk/keys.h>
#include <dt-bindings/zmk/outputs.h>
#include <dt-bindings/zmk/bt.h>
#include <dt-bindings/zmk/pointing.h>

// HOST_OS: Linux=1, MacOS=2
#define HOST_OS 1
#include "zmk-helpers/helper.h"



// Delay for combo
#undef COMBO_TERM
#define COMBO_TERM 250

// #define NAV_TAP_TERM 300
// #define TAPDANCE_2_TERM 250
// #define TAPDANCE_3_TERM 350
#define HOLDTAP_TERM         350
#define HOLDTAP_LAYER_TERM   350
#define TIMEOUT_STICKY_LAYER 1000
#define TIMEOUT_STICKY_KEY   2000

&sk {
  release-after-ms = <TIMEOUT_STICKY_KEY>;
  quick-release;
};
&sl { 
  release-after-ms = <TIMEOUT_STICKY_LAYER>;
};
&mt {
  tapping-term-ms = <HOLDTAP_TERM>;
};
&lt {
  tapping-term-ms = <HOLDTAP_LAYER_TERM>;
};


// Switches/keys Top to Bottom, Left to Right
#define T1 0
#define T2 1
#define T3 2

#define T4 3
#define T5 4
#define T6 5


#define M1 6
#define M2 7
#define M3 8

#define M4 9
#define M5 10
#define M6 11

#define B1 12
#define B2 13
// #define B3 14

// #define B4 15
#define B5 14
#define B6 15

#define L_AL1 0
#define L_AL2 1
#define L_NUM 2
#define L_FUN 3
#define L_PAR 4 
#define L_SYM 5
#define L_RXP 6
#define L_ACC 7
#define L_EDT 8
#define L_NAV 9
#define L_MSE 10
#define L_BLE 11



// #include "keyabbrev.dtsi"
#include "characters.conf"
#include "combonames.conf"
// #include "timeouts.dtsi"
// #include "behaviors.dtsi"

&mmv {
  time-to-max-speed-ms = <0>;
  acceleration-exponent = <0>;
};

&msc {
  time-to-max-speed-ms = <0>;
  acceleration-exponent = <0>;
};




/ { behaviors {
  
  hm: homerow_mods {
    compatible = "zmk,behavior-hold-tap";
    #binding-cells = <2>;
    tapping-term-ms = <300>;
    quick-tap-ms = <250>;
    require-prior-idle-ms = <250>;
    flavor = "tap-preferred";
    bindings = <&kp>, <&kp>;
  };
  
  hl: homerow_layers {
    compatible = "zmk,behavior-hold-tap";
    #binding-cells = <2>;
    tapping-term-ms = <300>;
    quick-tap-ms = <250>;
    require-prior-idle-ms = <250>;
    flavor = "tap-preferred";
    bindings = <&mo>, <&kp>;
//     retro-tap;
  };
  
  bspc_del: backspace_delete {
    compatible = "zmk,behavior-mod-morph";
    #binding-cells = <0>;
    bindings = <&kp BACKSPACE>, <&kp DELETE>;
    mods = <(MOD_LSFT|MOD_RSFT)>;
    keep-mods = <(MOD_LCTL|MOD_RCTL|MOD_RSFT)>;
  };
  
}; };

#define HLA(key) &hm LALT key
#define HLC(key) &hm LCTRL key
#define HRC(key) &hm RCTRL key
#define HLS(key) &hm LSHIFT key
#define HRS(key) &hm RSHIFT key


#define CB4(keypos, name, bindings, layers) \
  ZMK_COMBO(name, bindings, keypos, layers)


#define CB3(keypos, name, bindings) \
  ZMK_COMBO(name, bindings, keypos)
  
// Simple hold-tabs, tap-preferred
#define HTTP(name, ...)  \
  / { \
    behaviors { \
      name: name { \
        compatible = "zmk,behavior-hold-tap"; \
        flavor = "tap-preferred"; \
        tapping-term-ms = <HOLDTAP_TERM>; \
        #binding-cells = <2>;\
        __VA_ARGS__ \
      }; \
    }; \
  };

// Hold-Tap NoShift KeyPress
#define Unshift(name, keycode)  \
  / { \
    behaviors { \
      name: behavior_unshift_##name { \
        compatible = "zmk,behavior-mod-morph"; \
        #binding-cells = <0>;\
        bindings = <&kp keycode>, <&kp keycode>;\
        mods = <(MOD_LSFT|MOD_RSFT)>;\
        keep-mods = <(MOD_RALT)>; \
      }; \
    }; \
  };
  
Unshift(ns_dacu, D_ACU)
Unshift(ns_dgrv, D_GRV)
Unshift(ns_dcrc, D_CRC)

ZMK_MACRO(e_grave, bindings = <&ns_dgrv &kp E> ;)
ZMK_MACRO(e_dier,  bindings = <&kp D_DRS &kp E> ;)
HTTP(hold_egrv, bindings = <&e_dier>, <&e_grave>; )
#define H_EGRV &hold_egrv 0 0


ZMK_MACRO(e_acute, bindings = <&ns_dacu &kp E> ;)
ZMK_MACRO(e_circ,  bindings = <&ns_dcrc &kp E> ;)
HTTP(hold_eacu, bindings = <&e_circ>, <&e_acute>; )
#define H_EACU &hold_eacu 0 0

ZMK_MACRO(a_grave, bindings = <&ns_dgrv &kp A> ;)
ZMK_MACRO(a_circ,  bindings = <&ns_dcrc &kp A> ;)
HTTP(hold_agrv, bindings = <&a_circ>, <&a_grave>; )
#define H_AGRV &hold_agrv 0 0

ZMK_MACRO(u_grave, bindings = <&ns_dgrv &kp U> ;)
ZMK_MACRO(u_circ,  bindings = <&ns_dcrc &kp U> ;)
HTTP(hold_ugrv, bindings = <&u_grave>, <&u_circ>; )
#define H_UGRV &hold_ugrv 0 0



ZMK_MACRO(i_circ,  bindings = <&ns_dcrc &kp I >;)
ZMK_MACRO(i_dier,  bindings = <&kp D_DRS &kp I> ;)
HTTP(hold_icrc, bindings = <&i_dier>, <&i_circ>; )
#define H_ICRC &hold_icrc 0 0

ZMK_MACRO(o_circ,  bindings = <&ns_dcrc &kp O> ;)
ZMK_MACRO(o_dier,  bindings = <&kp D_DRS &kp O> ;)
HTTP(hold_ocrc, bindings = <&o_dier>, <&o_circ>; )
#define H_OCRC &hold_ocrc 0 0

// ZMK_MACRO(u_dier,  bindings = <&kp D_DRS &kp U> ;)




ZMK_MACRO(mhold_lt  , bindings = <&kp LT &kp GT &kp LEFT> ;)
HTTP(hold_lt, bindings = <&mhold_lt>, <&kp>; )
#define H_LT &hold_lt 0 LT

ZMK_MACRO(mhold_gt  , bindings = <&kp LT &kp FSLH &kp GT &kp LEFT> ;)
HTTP(hold_gt, bindings = <&mhold_gt>, <&kp>; )
#define H_GT &hold_gt 0 GT

ZMK_MACRO(mhold_lbrc, bindings = <&kp LBRC &kp RBRC &kp LEFT> ;)
HTTP(hold_lbrc, bindings = <&mhold_lbrc>, <&kp>; )
#define H_LBRC &hold_lbrc 0 LBRC

ZMK_MACRO(mhold_rbrc, bindings = <&kp LBRC &kp DOLLAR &kp RBRC &kp LEFT> ;)
HTTP(hold_rbrc, bindings = <&mhold_rbrc>, <&kp>; )
#define H_RBRC &hold_rbrc 0 RBRC

ZMK_MACRO(m_lrbrc, bindings = <&kp DOLLAR &kp LBRC &kp RBRC &kp LEFT> ;)
// HTTP(hold_lbrc, bindings = <&mhold_lbrc>, <&kp>; )

ZMK_MACRO(mhold_lbkt, bindings = <&kp LBKT &kp RBKT &kp LEFT> ;)
HTTP(hold_lbkt, bindings = <&mhold_lbkt>, <&kp>; )
#define H_LBKT &hold_lbkt 0 LBKT

ZMK_MACRO(mhold_rbkt, bindings = <&kp LBKT &kp CARET &kp RBKT &kp LEFT> ;)
HTTP(hold_rbkt, bindings = <&mhold_rbkt>, <&kp>; )
#define H_RBKT &hold_rbkt 0 RBKT

ZMK_MACRO(mhold_grv , bindings = <&kp GRAVE &kp GRAVE &kp LEFT> ;)
HTTP(hold_grv, bindings = <&mhold_grv>, <&kp>; )
#define H_GRV &hold_grv 0 GRAVE

ZMK_MACRO(mhold_sqt , bindings = <&kp SQT &kp SQT &kp LEFT> ;)
HTTP(hold_sqt, bindings = <&mhold_sqt>, <&kp>; )
#define H_SQT &hold_sqt 0 SQT

ZMK_MACRO(mhold_dqt , bindings = <&kp DQT &kp DQT &kp LEFT> ;)
HTTP(hold_dqt, bindings = <&mhold_dqt>, <&kp>; )
#define H_DQT &hold_dqt 0 DQT

ZMK_MACRO(dashgt , bindings = <&kp MINUS &kp GT> ;)

ZMK_MACRO(mhold_lpar, bindings = <&kp LPAR &kp RPAR &kp LEFT> ;)
HTTP(hold_lpar, bindings = <&mhold_lpar>, <&kp>; )
#define H_LPAR &hold_lpar 0 LPAR

ZMK_MACRO(mhold_rpar, bindings = <&kp LPAR &kp EXCL &kp RPAR &kp LEFT> ;)
HTTP(hold_rpar, bindings = <&mhold_rpar>, <&kp>; )
#define H_RPAR &hold_rpar 0 RPAR


ZMK_MACRO(mhold_amp  , bindings = <&kp AMPS &kp SEMI &kp LEFT> ;)
HTTP(hold_amp, bindings = <&mhold_amp>, <&kp>; )
#define H_AMPS &hold_amp 0 AMPS

ZMK_MACRO(mhold_eq  , bindings = <&kp EXCL &kp EQUAL> ;)
HTTP(hold_eq, bindings = <&mhold_eq>, <&kp>; )
#define H_EQ &hold_amp 0 EQUAL


// Combos L_NAV

CB4(LMM_, mute, &mt K_PP K_MUTE, L_NAV)


// Combos L_MSE
CB4(RT_T, mmid, M_B3, L_MSE)
CB4(RTT_, mbck, M_B4, L_MSE)
CB4(R_TT, mfwd, M_B5, L_MSE)

// Combos L_PAR, used for dev like -> => </>
CB4(R_TT, p_dashgt, &dashgt, L_PAR)
CB4(L_TT, p_lrbrc, &m_lrbrc, L_PAR)
// CB4(RMM_, p_dash, &kp MINUS, L_PAR)
// CB4(R_MM, p_eq  , &kp EQUAL, L_PAR)
// CB4(RMT_, p_slsh, &kp FSLH , L_PAR)

// combos L_NUM
// CB4(RMM_, n_euro, &kp EURO, L_NUM)
// CB4(R_MM, n_gbp , &kp GBP , L_NUM)

// combos L_EDT
// This is available in case some app cannot do LS(INS) LC(INS) 
CB4(L_MM, copypaste, &mt LC(V) LC(C), L_EDT)

CB4(B5 B6, midclck  , M_B3, L_EDT)
CB4(RTT_ , mouseback, M_RW, L_EDT)
CB4(R_TT , mousefrwd, M_FW, L_EDT)


// Combos Base layer
CB4(LTT_, esca, &kp ESC        , L_AL1)
CB4(L_TT, tabs, &mt LS(TAB) TAB, L_AL1)
CB4(LT_T, caps, &kp CAPS       , L_AL1)
CB4(LTTT, lgui, &sk LGUI       , L_AL1)
CB4(R_TT, dele, &kp DELETE     , L_AL1)
CB4(RTTT, rgui, &sk RGUI       , L_AL1)
CB4(RT_T, ralt, &sk RALT       , L_AL1)

CB4(RMM_, hlft, &mt HOME LEFT  , L_AL1)
CB4(R_MM, rend, &mt END  RIGHT , L_AL1)

CB4(RTM_, cbup, &kp UP   , L_AL1)
CB4(RMT_, cbdn, &kp DOWN , L_AL1)

CB4(RT_M, cpup, &kp PG_UP, L_AL1)
CB4(RM_T, cpdn, &kp PG_DN, L_AL1)


CB4(L_XX, reflash , &bootloader, L_AL1)
CB4(LX_X, blutooth, &sl L_BLE  , L_AL1)


// Combos ALL layers
CB3(RTT_, bksp, &kp BACKSPACE)
CB3(RM_M, entr, &kp ENTER)
// ①②③④⑤⑥⑦⑧⑨⑩⑪⑫⑴⑵⑶⑷⑸⑹⑺⑻⑼⑽⑾⑿⓵⓶⓷⓸⓹⓺⓻⓼⓽⓾⓫⓬

// T H E A N   D I G O F   R S C V     L M  u

/ { keymap { compatible = "zmk,keymap";
  alpha1 {
    display-name = "Alpha 1";
    bindings = <
      HLS(C)        HLA(D)        HLC(L)               HRC(O)        HLA(I)   HRS(N)
      &hl L_PAR S   &hl L_MSE T   &hl L_NAV R          &hl L_ACC A   &kp E    &hl L_RXP H
      &hl L_NUM U                 &hl L_EDT SPACE      &sl L_AL2              &hl L_SYM M
      
    >;
  };
  alpha2 {
    display-name = "Alpha 2";
    bindings = <
      &kp Q   &kp B   &kp V       &kp J   &kp F   &kp K
      &kp G   &kp P   &kp W       &kp X   &kp Y   &kp Z
//  Letters used in French, and some letters of the Cyrillic layout
      &kp BS_YU       &kp CC_CH   &kp OE_SH       &kp AE_SHT
    >;
  };
  numbers {
    display-name = "Numbers+Math";
    bindings = <
      &mt FSLH STAR  &mt PERCENT PLUS  &mt EQUAL MINUS     &mt EURO   N4  &mt GBP  N5  &mt DOLLAR N6
      &mt AMPS N7    &kp         N8    &kp       N9        &mt EXCL   N1  &mt SUP2 N2  &mt HASH   N3
      &mo L_NUM                        &mo L_FUN           &mt DEGREE N0               &mt COMMA DOT
      
    >;
  };
  
  functions {
    display-name = "Functions";
    bindings = <
      HLS(F10)  HLA(F11)  HLC(F12)     HRC(F4)  HLA(F5)  HRS(F6)
      &kp F7    &kp F8    &kp F9       &kp F1   &kp F2   &kp F3
      &mo L_NUM           &mo L_FUN    MAYBE             MAYBE
      
    >;
  };
  
  
  parentheses {
    display-name = "Parentheses";
    bindings = <
      MAYBE      H_LBRC  H_RBRC   H_LT    H_GT    H_EQ
      &mo L_PAR  H_LBKT  H_RBKT   H_LPAR  H_RPAR  &kp SEMI
      TODO               H_GRV    H_DQT           H_SQT 
    >;
  };
  
  
// TODO  punctuation; accents; edit shortcuts; macro words
// TODO  E_PRINT, PRINTSCREEN INSERT 

// 
// Maybe: +-=; 
// maybe not: ¥¡÷×«»“”¶¿
// dead grave tilde acute circ dier macron?
  
//   ~@&_|

//   SYM:  text, writing  ,.?!;:#*$   @/&     maybe: %
// /\ #* $ +- = @ %&
  symbols {
    display-name = "Symbols";
    bindings = <
      H_AMPS      &kp DOLLAR  &kp MINUS    &kp QMARK  &kp EXCL  &kp COLON  
      &kp HASH    &kp STAR    &kp AT       &kp COMMA  &kp DOT   &kp SEMI   
      &kp BSLH                &kp TILDE    &kp FSLH             &mo L_SYM
    >;
  };
  
//   regexp       -:   +*^$| 
  regexp {
    display-name = "RegExp";
    bindings = <
      &kp CARET &kp DOLLAR  &kp PIPE     &kp COLON  &kp MINUS  MAYBE
      &kp PLUS  &kp STAR    &kp QMARK    &kp BSLH   &kp FSLH   &mo L_RXP
      TODO                  TODO         TODO                  &kp DOT
    >;
  };
  
  
  accents {
    display-name = "Accents";
    bindings = <
      &kp CC_CH  &ns_dcrc  &kp D_DRS    MAYBE       H_OCRC  H_ICRC
      &kp S_SRP  &ns_dacu  &ns_dgrv     &mo L_ACC   H_AGRV  H_EACU
      H_UGRV               &kp D_TLD    &kp NTILDE          H_EGRV 
    >;
  };
  
  editing {
    // The left-hand shortcuts can be used while the right hand holds the mouse
    display-name = "Edit shortcuts + Mouse";
    bindings = <
      HLS(LC(R))  HLA(LC(F))  HLC(DEL)      M_SU   M_MU   M_SD
      E_SAVE      E_COPY      E_PASTE       M_ML   M_MD   M_MR
      E_UNDOREDO              &mo L_EDT     M_B1          M_B2 
    >;
  };
  
  
  navigation {
    display-name = "Navigation+Media";
    bindings = <
      &kp LSHIFT  &kp LALT  &kp LCTRL      &kp HOME   &kp UP    &kp END
      MM_VD       MM_VU     &mo L_NAV      &kp LEFT   &kp DOWN  &kp RIGHT
      NN_PREV               NN_NEXT        &kp PG_UP            &kp PG_DN 
      
    >;
  };
   
  
  mouse {
    display-name = "Mouse";
    bindings = <
      &kp LSHIFT  &kp LALT   &kp LCTRL    M_SU   M_MU    M_SD
      M_B2        &mo L_MSE  M_B1         M_ML   M_MD    M_MR
      TODO                   &kp LALT     M_B1           M_B2 
    >;
  };

  
  
  bluetooth {
    display-name = "Bluetooth";
    bindings = <
      TODO  TODO  &out OUT_USB    &bt BT_SEL 3  &bt BT_SEL 4  &bt BT_SEL 5
      TODO  TODO  &out OUT_BLE    &bt BT_SEL 0  &bt BT_SEL 1  &bt BT_SEL 2
      TODO        TODO            TODO                        TODO 
      // TODO: &bt BT_CLR
    >;
  };
  
  

}; };

