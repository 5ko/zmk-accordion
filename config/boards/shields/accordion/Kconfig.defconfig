## config/boards/shields/accordion/Kconfig.defconfig
```kconfig
if SHIELD_TEMPERANCE

config ZMK_KEYBOARD_NAME
	default "Accordion"

config I2C
	default y

config SSD1306
	default y

config LV_Z_VDB_SIZE
	default 64

config LV_DPI_DEF
	default 148

config LV_Z_BITS_PER_PIXEL
	default 1

choice LV_COLOR_DEPTH
	default LV_COLOR_DEPTH_1
endchoice



if ZMK_DISPLAY

config I2C
    default y

config SSD1306
    default y

endif # ZMK_DISPLAY

if LVGL

config LV_Z_VDB_SIZE
    default 64

config LV_DPI_DEF
    default 148

config LV_Z_BITS_PER_PIXEL
    default 1

choice LV_COLOR_DEPTH
    default LV_COLOR_DEPTH_1
endchoice

endif # LVGL

endif
```

## config/boards/shields/accordion/Kconfig.shield
```kconfig
# Copyright (c) 2024 Petko Yotov pmwiki.org/petko
# SPDX-License-Identifier: MIT

config SHIELD_TEMPERANCE
	def_bool $(shields_list_contains,accordion)
```
